## boards/config/shields/cygnus46/Kconfig.shield
```kconfig
config SHIELD_CYGNUS46_LEFT
    def_bool $(shields_list_contains,cygnus46_left)

config SHIELD_CYGNUS46_RIGHT
    def_bool $(shields_list_contains,cygnus46_right)
```

## boards/shields/cygnus46/Kconfig.defconfig
```kconfig
if SHIELD_CYGNUS46_LEFT

config ZMK_KEYBOARD_NAME
    default "Cygnus46"

config ZMK_SPLIT_ROLE_CENTRAL
    default y

endif

if SHIELD_CYGNUS46_LEFT || SHIELD_CYGNUS46_RIGHT

config ZMK_SPLIT
    default y

endif
```

## config/boards/shields/cygnus46/Kconfig.shield
```kconfig
config SHIELD_CYGNUS46_LEFT
    def_bool $(shields_list_contains,cygnus46_left)

config SHIELD_CYGNUS46_RIGHT
    def_bool $(shields_list_contains,cygnus46_right)

config SHIELD_CYGNUS46_DONGLE
    def_bool $(shields_list_contains,cygnus46_dongle)
```
